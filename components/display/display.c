#include "display.h"
#include "bsp.h"

#include "esp_lcd_panel_io.h"
#include "esp_lcd_panel_ops.h"
#include "esp_lcd_panel_vendor.h"
#include "esp_lcd_panel_ssd1306.h"
#include "esp_log.h"

#include <string.h>
#include <stdio.h>

#define DISPLAY_W   128
#define DISPLAY_H    64
#define FONT_W        6
#define FONT_H        8
#define COLS        (DISPLAY_W / FONT_W)   /* 21 */
#define ROWS        (DISPLAY_H / FONT_H)   /*  8 */

static const char *TAG = "display";

static esp_lcd_panel_handle_t s_panel = NULL;

/*
 * Minimal 6x8 bitmap font for printable ASCII (0x20–0x7e).
 * Each character is 5 columns of 8 bits, padded to 6 with a blank column.
 */
static const uint8_t FONT6x8[][5] = {
    {0x00,0x00,0x00,0x00,0x00}, /* ' ' */
    {0x00,0x00,0x5F,0x00,0x00}, /* '!' */
    {0x00,0x07,0x00,0x07,0x00}, /* '"' */
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    {0x10,0x08,0x08,0x10,0x08}, /* '~' */
};

/* 1-bit framebuffer: 128x64 = 1024 bytes */
static uint8_t s_fb[DISPLAY_H / 8][DISPLAY_W];

static void fb_set_pixel(int x, int y, bool on)
{
    if (x < 0 || x >= DISPLAY_W || y < 0 || y >= DISPLAY_H) return;
    if (on) s_fb[y / 8][x] |=  (1 << (y % 8));
    else    s_fb[y / 8][x] &= ~(1 << (y % 8));
}

static void fb_draw_char(int x, int y, char c)
{
    if (c < 0x20 || c > 0x7e) c = '?';
    const uint8_t *glyph = FONT6x8[c - 0x20];
    for (int col = 0; col < 5; col++) {
        uint8_t bits = glyph[col];
        for (int row = 0; row < 8; row++) {
            fb_set_pixel(x + col, y + row, (bits >> row) & 1);
        }
    }
    /* blank spacing column */
    for (int row = 0; row < 8; row++) fb_set_pixel(x + 5, y + row, false);
}

esp_err_t display_init(void)
{
    i2c_master_bus_handle_t bus = bsp_i2c_get_bus();
    if (!bus) {
        ESP_LOGE(TAG, "I2C bus not initialized");
        return ESP_ERR_INVALID_STATE;
    }

    esp_lcd_panel_io_handle_t io;
    esp_lcd_panel_io_i2c_config_t io_cfg = {
        .dev_addr            = 0x3C,
        .scl_speed_hz        = 400000,
        .control_phase_bytes = 1,
        .dc_bit_offset       = 6,
        .lcd_cmd_bits        = 8,
        .lcd_param_bits      = 8,
    };
    esp_err_t ret = esp_lcd_new_panel_io_i2c(bus, &io_cfg, &io);
    if (ret != ESP_OK) {
        ESP_LOGE(TAG, "panel IO init failed: %s", esp_err_to_name(ret));
        return ret;
    }

    esp_lcd_panel_dev_config_t panel_cfg = {
        .reset_gpio_num = -1,
        .bits_per_pixel = 1,
    };
    ret = esp_lcd_new_panel_ssd1306(io, &panel_cfg, &s_panel);
    if (ret != ESP_OK) {
        ESP_LOGE(TAG, "SSD1306 panel init failed: %s", esp_err_to_name(ret));
        return ret;
    }

    esp_lcd_panel_reset(s_panel);
    esp_lcd_panel_init(s_panel);
    esp_lcd_panel_mirror(s_panel, true, true);  /* 180° — segment remap + COM scan */
    esp_lcd_panel_disp_on_off(s_panel, true);

    display_clear();
    ESP_LOGI(TAG, "SSD1306 ready (128x64 @ 0x3C)");
    return ESP_OK;
}

void display_clear(void)
{
    memset(s_fb, 0, sizeof(s_fb));
    display_flush();
}

void display_print(uint8_t row, const char *text)
{
    if (row >= ROWS) return;
    int y = row * FONT_H;
    /* clear the row first */
    for (int x = 0; x < DISPLAY_W; x++) s_fb[row][x] = 0;
    for (int col = 0; col < COLS && text[col]; col++) {
        fb_draw_char(col * FONT_W, y, text[col]);
    }
}

void display_flush(void)
{
    if (!s_panel) return;
    /* esp_lcd expects the buffer as rows of bytes, one bit per pixel.
       Our framebuffer layout matches directly. */
    esp_lcd_panel_draw_bitmap(s_panel, 0, 0, DISPLAY_W, DISPLAY_H, s_fb);
}

void display_sleep(void)
{
    if (!s_panel) return;
    memset(s_fb, 0, sizeof(s_fb));
    display_flush();                           /* push blank frame first */
    esp_lcd_panel_disp_on_off(s_panel, false); /* send SSD1306 display-off cmd (0xAE) */
}
