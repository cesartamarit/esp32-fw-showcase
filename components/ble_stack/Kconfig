## components/ble_stack/Kconfig
```kconfig
menu "BLE Stack"

    config BLE_DEVICE_NAME
        string "BLE advertised device name"
        default "KodeFW"
        help
            Name visible when scanning from a phone or nRF Connect.

    config BLE_TASK_STACK_SIZE
        int "NimBLE host task stack size (bytes)"
        default 4096

endmenu
```

## components/bsp/Kconfig
```kconfig
menu "Board Support Package"

    config BSP_LED_GPIO
        int "LED GPIO number"
        default 48
        help
            GPIO number for the onboard LED.
            ESP32-S3-DevKitC-1 uses GPIO48.

    config BSP_BUTTON_GPIO
        int "Boot button GPIO number"
        default 0
        help
            GPIO number for the onboard boot button.

    config BSP_I2C_SDA_GPIO
        int "I2C SDA GPIO number"
        default 8

    config BSP_I2C_SCL_GPIO
        int "I2C SCL GPIO number"
        default 9

    config BSP_I2C_FREQ_HZ
        int "I2C bus frequency (Hz)"
        default 400000
        help
            Standard mode: 100000, Fast mode: 400000.

endmenu
```

## components/encoder/Kconfig
```kconfig
menu "Rotary Encoder"

    config ENCODER_CLK_GPIO
        int "Encoder CLK (A) GPIO"
        default 4

    config ENCODER_DT_GPIO
        int "Encoder DT (B) GPIO"
        default 5

    config ENCODER_SW_GPIO
        int "Encoder SW (button) GPIO"
        default 6

endmenu
```

## components/motors/Kconfig
```kconfig
menu "Motors Configuration"

    config MOTORS_ENABLED
        bool "Enable motors (servo + stepper)"
        default y
        help
            When disabled, motors_init() is a no-op and all motor BLE commands
            are silently ignored.  Set to n to build the 'no-motors' binary used
            in the OTA update demo.

    config MOTORS_SERVO_GPIO
        int "Servo signal GPIO"
        default 15
        help
            GPIO connected to the servo signal wire (orange/yellow).

    config MOTORS_STEPPER_IN1_GPIO
        int "Stepper IN1 GPIO"
        default 11

    config MOTORS_STEPPER_IN2_GPIO
        int "Stepper IN2 GPIO"
        default 12

    config MOTORS_STEPPER_IN3_GPIO
        int "Stepper IN3 GPIO"
        default 13

    config MOTORS_STEPPER_IN4_GPIO
        int "Stepper IN4 GPIO"
        default 14

endmenu
```

## components/ota_manager/Kconfig
```kconfig
menu "OTA Manager"

    config OTA_MANAGER_FIRMWARE_URL
        string "Firmware update URL"
        default "http://192.168.1.100:8080/esp32-fw-showcase.bin"
        help
            URL where the firmware binary is hosted.
            For local demo: run 'python3 -m http.server 8080' in the build dir
            and set this to http://<your-laptop-IP>:8080/<binary-name>.
            For production: use an HTTPS URL (GitHub Releases, S3, etc.).

    config OTA_MANAGER_RECV_TIMEOUT_MS
        int "HTTP receive timeout (ms)"
        default 5000

    config OTA_MANAGER_TASK_STACK_SIZE
        int "OTA task stack size (bytes)"
        default 8192

endmenu
```

## components/power_mgr/Kconfig
```kconfig
menu "Power Manager"

    config POWER_MGR_MAX_CPU_FREQ_MHZ
        int "Maximum CPU frequency (MHz)"
        default 240
        help
            ESP32-S3 supports up to 240 MHz.

    config POWER_MGR_MIN_CPU_FREQ_MHZ
        int "Minimum CPU frequency (MHz)"
        default 40
        help
            Minimum frequency when idle. Lower = less power.

    config POWER_MGR_DEEP_SLEEP_TIMEOUT_S
        int "Deep sleep inactivity timeout (seconds)"
        default 30
        help
            Enter deep sleep after this many seconds without activity.
            Set to 0 to disable automatic deep sleep.

endmenu
```

## components/wifi_mgr/Kconfig
```kconfig
menu "WiFi Configuration"

    config WIFI_SSID
        string "WiFi SSID"
        default "your_ssid"
        help
            SSID of the access point used for OTA firmware updates.

    config WIFI_PASSWORD
        string "WiFi Password"
        default ""
        help
            Leave empty for open networks.

endmenu
```

## sdkconfig.defaults
```kconfig
# Target
CONFIG_IDF_TARGET="esp32s3"

# Flash
CONFIG_ESPTOOLPY_FLASHSIZE_8MB=y
CONFIG_ESPTOOLPY_FLASHSIZE="8MB"

# FreeRTOS
CONFIG_FREERTOS_HZ=1000
CONFIG_FREERTOS_USE_TRACE_FACILITY=y

# BLE
CONFIG_BT_ENABLED=y
CONFIG_BT_BLUEDROID_ENABLED=n
CONFIG_BT_NIMBLE_ENABLED=y

# WiFi — override in your local sdkconfig (gitignored) with real credentials
CONFIG_ESP_WIFI_ENABLED=y
CONFIG_WIFI_SSID="YOUR_SSID"
CONFIG_WIFI_PASSWORD="YOUR_PASSWORD"
# BT+WiFi software coexistence (required to use both simultaneously)
CONFIG_ESP_COEX_ENABLED=y
CONFIG_ESP_COEX_SW_COEXIST_ENABLE=y

# OTA — custom 8MB partition table (two 2MB OTA slots)
CONFIG_BOOTLOADER_APP_ROLLBACK_ENABLE=y
CONFIG_PARTITION_TABLE_CUSTOM=y
CONFIG_PARTITION_TABLE_CUSTOM_FILENAME="partitions.csv"
# Allow HTTP URLs in addition to HTTPS (useful for local demo server)
CONFIG_ESP_HTTPS_OTA_ALLOW_HTTP=y
# Mozilla CA bundle — validates GitHub / public HTTPS servers without embedding a cert
CONFIG_MBEDTLS_CERTIFICATE_BUNDLE=y
CONFIG_MBEDTLS_CERTIFICATE_BUNDLE_DEFAULT_FULL=y

# Power management
CONFIG_PM_ENABLE=y
CONFIG_FREERTOS_USE_TICKLESS_IDLE=y
CONFIG_POWER_MGR_DEEP_SLEEP_TIMEOUT_S=60
CONFIG_POWER_MGR_WAKE_GPIO=6

# Logging
CONFIG_LOG_DEFAULT_LEVEL_INFO=y

# OTA — firmware URL for next release (used when OTA Update is triggered)
CONFIG_OTA_MANAGER_FIRMWARE_URL="https://github.com/cesartamarit/esp32-fw-showcase/releases/download/v1.5.0/esp32-fw-showcase-v1.5.0.bin"

# Motors — servo + stepper enabled (start paused, activate via BLE)
CONFIG_MOTORS_ENABLED=y
```
